## Documentation/devicetree/bindings/misc/amd,apml-alertl.yaml
```yaml
# SPDX-License-Identifier: (GPL-2.0-only OR BSD-2-Clause)
%YAML 1.2
---
$id: http://devicetree.org/schemas/hwmon/amd,apml-alertl.yaml#
$schema: http://devicetree.org/meta-schemas/core.yaml#

title: >
  Sideband Remote Management Interface (SB-RMI) and Temperature Sensor Interface
  (SB-TSI) compliant AMD APML Alert_L GPIO.

maintainers:
  - Akshay Gupta <Akshay.Gupta@amd.com>

description: |
  Processors from AMD provide APML ALERT_L for BMC users to
  monitor events.
  APML Alert_L is asserted in multiple events,
  - Machine Check Exception occurs within the system
  - The processor alerts the SBI on system fatal error event
  - Set by hardware as a result of a 0x71/0x72/0x73 command completion
  - Set by firmware to indicate the completion of a mailbox operation
  - High/Low Temperature Alert

  APML Alert_L module define uevents to notify userspace of the
  alert event.

properties:
  compatible:
    const: apml-alertl

  gpio:
    maxItems: 1
    description: |
     GPIO specifier for APML Alert_L line. Specify GPIO controller, GPIO pin
     and polarity.

  socket-num:
   $ref: /schemas/types.yaml#/definitions/uint32
   minimum: 0
   maximum: 255
   description: |
    Socket identifier for multi-socket AMD systems. This property identifies
    which CPU socket this Alert_L GPIO is associated with.

required:
  - compatible
  - gpio
  - socket-num

additionalProperties: false

examples:
  - |
    /* Alert_L associated with Socket 0 */
    alertl_sock0 {
        compatible = "apml-alertl";
        status = "okay";
        gpios = <&ltpi0_gpio 20 GPIO_ACTIVE_LOW>;
        socket-num =  /bits/ 8 <1>;
    };
...
```

## drivers/misc/amd-apml/Kconfig
```kconfig
# SPDX-License-Identifier: GPL-2.0-only
#
# AMD APML BMC interface drivers
#

config APML_COMMON
    tristate "AMD APML common device registration framework"
    default n
    help
      Enable support for the AMD APML (Advanced Platform Management Link)
      common device registration framework. This module provides a centralized
      registry where APML devices (SBRMI and SBTSI) can register themselves
      for discovery by other APML subsystems.

      This framework enables the Alert_L driver to safely discover and access
      registered APML devices for alert processing across multiple sockets.

config APML_SBRMI
    tristate "Emulated SB-RMI interface driver over i3c bus"
    depends on I3C && !SENSORS_SBRMI
    depends on APML_COMMON
    select REGMAP_I3C if I3C
    help
      If you say yes here you get support for emulated RMI
      interface on AMD SoCs with APML interface connected to a BMC device.

      This driver can also be built as a module. If so, the module will
      be called apml_sbrmi.

config APML_SBTSI
    tristate "Emulated SB-TSI interface driver over i3c bus"
    depends on I3C && !SENSORS_SBTSI
    depends on APML_COMMON
    select REGMAP_I3C if I3C
    help
      If you say yes here you get support for emulated TSI
      interface on AMD SoCs with APML interface connected to a BMC device.

      This driver can also be built as a module. If so, the module will
      be called apml_sbtsi.

config APML_ALERTL
    tristate "Emulated apml alertl interface driver over i3c bus"
    depends on APML_SBRMI && APML_SBTSI
    default n
    help
      This driver provides support for AMD APML Alert_L interface,
      enabling alert notification from AMD SoCs to a BMC (Baseboard
      Management Controller) over I2C/I3C bus.

      The driver monitors RAS and thermal events by handling alerts
      from SBRMI and SBTSI devices, and reports these events to userspace
      via uevents. Device configuration is managed via device tree bindings.

      This driver can also be built as a module. If so, the module will
      be called apml_alertl.ko.
```

## drivers/misc/apml-modules/Kconfig
```kconfig
# SPDX-License-Identifier: GPL-2.0-only
menu "APML driver support"

config APML_SBRMI
    tristate "AMD side band RMI support"
    depends on I3C
    help
      Side band RMI over I3C support for AMD out of band management.

      This driver can also be built as a module.

config APML_SBTSI
    tristate "AMD side band TSI support"
    depends on I3C
    help
      Side band TSI over I3C support for AMD out of band management.

      This driver can also be built as a module.
endmenu
```

## drivers/soc/aspeed/Kconfig
```kconfig
# SPDX-License-Identifier: GPL-2.0-only

if ARCH_ASPEED || COMPILE_TEST

menu "ASPEED SoC drivers"

config ASPEED_BMC_DEV
	tristate "ASPEED BMC Device"

config ASPEED_LPC_CTRL
	tristate "ASPEED LPC firmware cycle control"
	select REGMAP
	select MFD_SYSCON
	default ARCH_ASPEED
	help
	  Control LPC firmware cycle mappings through ioctl()s. The driver
	  also provides a read/write interface to a BMC ram region where the
	  host LPC read/write region can be buffered.

config ASPEED_LPC_SNOOP
	tristate "ASPEED LPC snoop support"
	select REGMAP
	select MFD_SYSCON
	default ARCH_ASPEED
	help
	  Provides a driver to control the LPC snoop interface which
	  allows the BMC to listen on and save the data written by
	  the host to an arbitrary LPC I/O port.

config ASPEED_UART_ROUTING
	tristate "ASPEED uart routing control"
	select REGMAP
	select MFD_SYSCON
	default ARCH_ASPEED
	help
	  Provides a driver to control the UART routing paths, allowing
	  users to perform runtime configuration of the RX muxes among
	  the UART controllers and I/O pins.

config ASPEED_SOCINFO
	bool "ASPEED SoC Information driver"
	default ARCH_ASPEED
	select SOC_BUS
	default ARCH_ASPEED
	help
	  Say yes to support decoding of ASPEED BMC information.

config ASPEED_XDMA
        tristate "ASPEED XDMA Engine Driver"
        select REGMAP
        select MFD_SYSCON
        depends on HAS_DMA
        help
          Enable support for the XDMA Engine found on the ASPEED BMC
          SoCs. The XDMA engine can perform PCIe DMA operations between the BMC
          and a host processor.

config AST2600_ESPI
	tristate "ASPEED AST2600 eSPI slave driver"
	help
	  Enable driver support for Aspeed AST2600 eSPI engine. The eSPI engine
	  plays as a slave device in BMC to communicate with the Host over
	  the eSPI interface. The four eSPI channels, namely peripheral,
	  virtual wire, out-of-band, and flash are supported.

config AST2700_ESPI
	tristate "ASPEED AST2700 eSPI slave driver"
	help
	  Enable driver support for Aspeed AST2700 eSPI engine. The eSPI engine
	  plays as a slave device in BMC to communicate with the Host over
	  the eSPI interface. The four eSPI channels, namely peripheral,
	  virtual wire, out-of-band, and flash are supported.

config AST2700_RTC_OVER_ESPI
	tristate "ASPEED AST2700 RTC over eSPI drvier"
	depends on HAS_IOMEM
	help
	  Enable driver support for Aspeed AST2700 RTC over eSPI function.
	  Periodically copies RAM content from a RTC tm to a memory-mapped eSPI region.

config ASPEED_LPC_PCC
	tristate "Aspeed Post Code Capture support"
	depends on ARCH_ASPEED && REGMAP && MFD_SYSCON
	help
	  Provides a driver to control the LPC PCC interface,
	  allowing the BMC to snoop data bytes written by the
	  the host to an arbitrary LPC I/O port.

config ASPEED_UDMA
	tristate "Aspeed UDMA Engine Driver"
	depends on ARCH_ASPEED && REGMAP && MFD_SYSCON && HAS_DMA
	help
	  Enable support for the Aspeed UDMA Engine found on the Aspeed AST2XXX
	  SOCs. The UDMA engine can perform UART DMA operations between the memory
	  buffer and the UART/VUART devices.

config ASPEED_DISP_INTF
	bool "ASPEED Display Interface driver"
	select REGMAP
	select MFD_SYSCON
	default ARCH_ASPEED
	help
	  Say yes to support control the display interface of ASPEED BMC.

endmenu

endif
```

## drivers/usb/misc/lstp/Kconfig
```kconfig
# SPDX-License-Identifier: GPL-2.0

config USB_LSTP
	tristate "NVIDIA LSTP USB Adapter support"
	depends on USB
	depends on I2C
	depends on SPI
	depends on GPIOLIB
	depends on TTY
	help
	  This adds support for the NVIDIA Low-Speed Transport Protocol (LSTP)
	  USB adapter. The LSTP adapter provides USB-to-I2C, USB-to-SPI,
	  USB-to-GPIO, USB-to-UART, and USB-to-IPMI interfaces for host
	  communication with connected devices.

	  This driver can also be built as a module. If so, the module will be
	  called lstp.

config USB_LSTP_DEBUG
	bool "Debug messages for LSTP/OBMF USB driver"
	depends on USB_LSTP
	help
	  Enable verbose protocol debug messages for the LSTP/OBMF USB driver at
	  compile time. This promotes dev_dbg() calls to dev_info() so probe
	  and channel I/O flow is visible in dmesg without runtime setup.

config USB_LSTP_USB_TRACE
	bool "Compile-time USB bulk traffic trace for LSTP/OBMF driver"
	depends on USB_LSTP
	help
	  Always log raw USB bulk TX/RX bytes from the OBMF driver to the kernel
	  log (dev_info) at compile time. This is intended for boot-time probe
	  debugging where there is no opportunity to enable dynamic debug or
	  usbmon manually.

	  Each transfer logs endpoint, length, and up to 64 data bytes. Enable
	  CONFIG_USB_LSTP_DEBUG as well for full protocol-level messages.

config SEPARATE_LSTP_IPMI_POSTCODES
	bool "Separate LSTP IPMI post codes writes to another channel"
	depends on USB_LSTP
	help
	  Enable this option to route IPMI post code writes to a separate
	  miscdevice instead of the main IPMI message path. Since POST codes
	  do not require a response, this allows faster processing by
	  bypassing the standard IPMI request-response handling.
```

## net/mctp/Kconfig
```kconfig
menuconfig MCTP
	depends on NET
	bool "MCTP core protocol support"
	help
	  Management Component Transport Protocol (MCTP) is an in-system
	  protocol for communicating between management controllers and
	  their managed devices (peripherals, host processors, etc.). The
	  protocol is defined by DMTF specification DSP0236.

	  This option enables core MCTP support. For communicating with other
	  devices, you'll want to enable a driver for a specific hardware
	  channel.

config MCTP_TEST
        bool "MCTP core tests" if !KUNIT_ALL_TESTS
        depends on MCTP=y && KUNIT=y
        default KUNIT_ALL_TESTS

config MCTP_FLOWS
	bool
	depends on MCTP
	select SKB_EXTENSIONS

config MCTP_SERIALIZE_PER_BUS
	bool "Serialize MCTP requests per bus"
	depends on MCTP
	help
	  This option enables per-bus serialization of MCTP requests.
	  When enabled, only one MCTP request can be transmitted on a
	  given bus at a time. The transmit lock is held from when a
	  request is sent until either a response is received or a
	  timeout occurs.

	  This is useful for buses that require strict request/response
	  serialization, such as certain I2C or SMBus implementations.

	  If unsure, say N.
```
